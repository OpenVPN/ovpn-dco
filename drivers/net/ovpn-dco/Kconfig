## drivers/net/ovpn-dco/Kconfig
```kconfig
# SPDX-License-Identifier: GPL-2.0
# Copyright (C) 2020 OpenVPN, Inc.
#
#  Author:	Antonio Quartulli <antonio@openvpn.net>

config OVPN_DCO
	tristate "OpenVPN data channel offload"
	depends on NET && INET
	select NET_UDP_TUNNEL
	select CRYPTO
	select CRYPTO_AEAD
	help
	  This module enhances the performance of the OpenVPN userspace software
	  by offloading the data channel processing to kernelspace.
```

## net/ovpn-dco/Kconfig
```kconfig
# SPDX-License-Identifier: GPL-2.0
# Copyright (C) 2020 OpenVPN, Inc.
#
#  Author:	Antonio Quartulli <antonio@openvpn.net>

config OVPN_DCO
	tristate "OpenVPN data channel offload"
	depends on NET
	help
	  This module enhances the performance of the OpenVPN userspace software
	  by offliading the data channel processing to kernelspace.
```
